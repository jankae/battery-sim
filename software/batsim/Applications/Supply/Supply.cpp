#include "Supply.h"

#include "pushpull.h"
#include "gui.h"
#include "file.h"

static const uint16_t imagedata[1024] = {
0x0000,0x0000,0x0000,0x0000,0x0000,0x0000,0x0000,0x0000,0x0000,0x0000,0x0000,0x0000,0x0000,0x0000,0x0000,0x0000,0x0000,0x0000,0x0000,0x0000,0x0000,0x0000,0x0000,0x0000,0x0000,0x0000,0x0000,0x0000,0x0000,0x0000,0x0000,0x0000,
0x0000,0x0000,0x0000,0x0000,0xffff,0xffff,0xffff,0xffff,0xffff,0xffff,0xffff,0xffff,0xffff,0xffff,0xffff,0xffff,0xffff,0xffff,0xffff,0xffff,0xffff,0xffff,0xffff,0xffff,0xffff,0xffff,0xffff,0xffff,0x0000,0x0000,0x0000,0x0000,
0x0000,0x0000,0xffff,0xffff,0xbdf7,0xbdf7,0xbdf7,0xbdf7,0xbdf7,0xbdf7,0xbdf7,0xbdf7,0xbdf7,0xbdf7,0xbdf7,0xbdf7,0xbdf7,0xbdf7,0xbdf7,0xbdf7,0xbdf7,0xbdf7,0xbdf7,0xbdf7,0xbdf7,0xbdf7,0xbdf7,0xbdf7,0xffff,0xffff,0x0000,0x0000,
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0x0000,0x0000,0x0000,0x0000,0x0000,0x0000,0x0000,0x0000,0x0000,0x0000,0x0000,0x0000,0x0000,0x0000,0x0000,0x0000,0x0000,0x0000,0x0000,0x0000,0x0000,0x0000,0x0000,0x0000,0x0000,0x0000,0x0000,0x0000,0x0000,0x0000,0x0000,0x0000,
};

static Image_t icon = { .width = 32, .height = 32, .data = imagedata };

static TaskHandle_t handle;

int32_t vol, source, sink;
static const fileEntry_t SupplyConfig[3] = {
		{ "voltage",&vol, PTR_INT32 },
		{ "source", &source, PTR_INT32 },
		{ "sink", &sink, PTR_INT32 },
};

static void Supply(void *unused);

static void Supply_Start(){
	xTaskCreate(Supply, "Supply", 600, NULL, 3, NULL);
}

void Supply_Init() {
	App_Register("Bench Supply", Supply_Start, icon);
}

static uint8_t loadDialog = 0;
static void load(widget_t *w) {
	loadDialog = 1;
	xTaskNotify(handle, SIGNAL_WAKEUP, eSetBits);
}

static uint8_t saveDialog = 0;
static void save(widget_t *w) {
	saveDialog = 1;
	xTaskNotify(handle, SIGNAL_WAKEUP, eSetBits);
}

static void Supply(void *unused) {
	handle = xTaskGetCurrentTaskHandle();

	int32_t voltage, current, power;

	int32_t setVoltage = 0, setMaxCurrent = 0, setMinCurrent = 0;
	int32_t null = 0;

	uint8_t on = 0;

	/* create GUI */
	/* Read back of current/voltage */
	entry_t *eSetVoltage = entry_new(&setVoltage, &Limits.maxVoltage, &Limits.minVoltage, Font_Big, 7, &Unit_Voltage);
	entry_t *eMaxCurrent = entry_new(&setMaxCurrent, &Limits.maxCurrent, &null, Font_Big, 7, &Unit_Current);
	entry_t *eMinCurrent = entry_new(&setMinCurrent, &Limits.minCurrent, &null, Font_Big, 7, &Unit_Current);

	label_t *lVol = label_newWithText("Voltage set:", Font_Big);
	label_t *lMax = label_newWithText("Source I set:", Font_Big);
	label_t *lMin = label_newWithText("Sink I set:", Font_Big);

	button_t *bLoad = button_new("Load", Font_Big, 0, load);
	button_t *bSave = button_new("Save", Font_Big, 0, save);

	sevensegment_t *sVol = sevensegment_new(&voltage, 20, 7, 5, 2, COLOR_DARKGREEN);
	sevensegment_t *sCur = sevensegment_new(&current, 20, 7, 5, 3, COLOR_RED);
	sevensegment_t *sPow = sevensegment_new(&power, 20, 7, 5, 2, COLOR_BLUE);

	label_t *lV = label_newWithText("V", Font_Big);
	lV->color = COLOR_DARKGREEN;
	label_t *lA = label_newWithText("A", Font_Big);
	lA->color = COLOR_RED;
	label_t *lW = label_newWithText("W", Font_Big);
	lW->color = COLOR_BLUE;

	label_t *lOutput = label_newWithText("Output", Font_Big);
	label_t *lOn = label_newWithLength(6, Font_Big, LABEL_CENTER);
	label_SetText(lOn, "OFF");
	lOn->color = COLOR_GRAY;

	container_t *c= container_new(COORDS(280, 240));

	container_attach(c, (widget_t*) sVol, COORDS(100, 0));
	container_attach(c, (widget_t*) sCur, COORDS(100, 55));
	container_attach(c, (widget_t*) sPow, COORDS(100, 110));

	container_attach(c, (widget_t*) lV, COORDS(267, 3));
	container_attach(c, (widget_t*) lA, COORDS(267, 58));
	container_attach(c, (widget_t*) lW, COORDS(267, 113));

	container_attach(c, (widget_t*) lOutput, COORDS(5, 9));
	container_attach(c, (widget_t*) lOn, COORDS(5, 27));

	container_attach(c, (widget_t*) bLoad, COORDS(5, 120));
	container_attach(c, (widget_t*) bSave, COORDS(5, 150));

	container_attach(c, (widget_t*) lVol, COORDS(0, 182));
	container_attach(c, (widget_t*) eSetVoltage, COORDS(190, 180));
	container_attach(c, (widget_t*) lMax, COORDS(0, 202));
	container_attach(c, (widget_t*) eMaxCurrent, COORDS(190, 200));
	container_attach(c, (widget_t*) lMin, COORDS(0, 222));
	container_attach(c, (widget_t*) eMinCurrent, COORDS(190, 220));

	c->base.position.x = 40;

	desktop_AppStarted(Supply_Start, (widget_t*) c);
	uint32_t signal;

	pushpull_AcquireControl();
	pushpull_SetAveraging(300);
	pushpull_SetDriveCurrent(200);
	pushpull_SetEnabled(0);
	pushpull_SetInternalResistance(0);

	while(1) {
		/* Update values */
		voltage = pushpull_GetBatteryVoltage()/10000;
		current = pushpull_GetCurrent()/1000;
		power = voltage * current / 1000;
		widget_RequestRedraw((widget_t*) sVol);
		widget_RequestRedraw((widget_t*) sCur);
		widget_RequestRedraw((widget_t*) sPow);

		pushpull_SetVoltage(setVoltage);
		pushpull_SetSourceCurrent(setMaxCurrent);
		pushpull_SetSinkCurrent(setMinCurrent);

		if (on != pushpull_GetEnabled()) {
			pushpull_SetEnabled(on);
			if (pushpull_GetEnabled()) {
				label_SetText(lOn, "ON");
				lOn->color = COLOR_RED;
			} else {
				label_SetText(lOn, "OFF");
				lOn->color = COLOR_GRAY;
			}
			on = pushpull_GetEnabled();
		}

		if (App_Handler(&signal, 300)) {
			/* received a notification */
			if (signal & SIGNAL_ONOFF_BUTTON) {
				on = !on;
			}
			if (signal & SIGNAL_PUSHPULL_UPDATE) {
				/* already handled in while(1) loop, nothing to do here */
			}
			if (loadDialog) {
				char filename[_MAX_LFN + 1];
				if (dialog_FileChooser("Select Preset:", filename, "0:/", "SUP")
						== DIALOG_RESULT_OK) {
					if (file_open(filename, FA_OPEN_EXISTING | FA_READ) == FR_OK
							&& file_ReadParameters(SupplyConfig, 3)
									== FILE_OK) {
						/* got all new parameters */
						on = 0;
						setVoltage = vol;
						setMaxCurrent = source;
						setMinCurrent = sink;
						file_close();
					} else {
						dialog_MessageBox("Error", Font_Big,
								"Failed to read file", MSG_OK, NULL, 1);
					}
				}
				loadDialog = 0;
			}
			if (saveDialog) {
				char filename[_MAX_LFN + 1];
				if (dialog_StringInput("Preset name:", filename, _MAX_LFN - 4)
						== DIALOG_RESULT_OK) {
					/* add file extension */
					strcat(filename, ".SUP");
					vol = setVoltage;
					source = setMaxCurrent;
					sink = setMinCurrent;
					if (file_open(filename, FA_CREATE_ALWAYS | FA_WRITE)
							!= FR_OK) {
						dialog_MessageBox("Error", Font_Big,
								"Failed to write file", MSG_OK, NULL, 1);
					} else {
						file_WriteParameters(SupplyConfig, 3);
						file_close();
					}
				}
				saveDialog = 0;
			}
		}
	}
}

